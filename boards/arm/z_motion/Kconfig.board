## boards/arm/z_motion/Kconfig.board
```kconfig
# Z Motion board configuration

# Copyright (c) 2023 CATIE
# SPDX-License-Identifier: Apache-2.0

config BOARD_Z_MOTION
	bool "Z Motion Board"
	depends on SOC_NRF52833_QIAA
```

## boards/arm/z_motion/Kconfig.defconfig
```kconfig
# Z Motion board configuration

# Copyright (c) 2023 CATIE
# SPDX-License-Identifier: Apache-2.0

if BOARD_Z_MOTION

config BOARD
	default "z_motion"

config BT_CTLR
	default BT

endif # BOARD_Z_MOTION
```

## boards/arm/z_motion/z_motion_defconfig
```kconfig
# SPDX-License-Identifier: Apache-2.0

CONFIG_SOC_SERIES_NRF52X=y
CONFIG_SOC_NRF52833_QIAA=y
CONFIG_BOARD_Z_MOTION=y

# Enable MPU
CONFIG_ARM_MPU=y

# Enable hardware stack protection
CONFIG_HW_STACK_PROTECTION=y

# Enable RTT
CONFIG_USE_SEGGER_RTT=y

# enable GPIO
CONFIG_GPIO=y

CONFIG_PINCTRL=y
```

## boards/catie/z_motion/Kconfig.z_motion
```kconfig
# Copyright (c) 2023 CATIE
# SPDX-License-Identifier: Apache-2.0

config BOARD_Z_MOTION
	select SOC_NRF52833_QIAA
```

## boards/catie/z_motion/board.yml
```yaml
board:
  name: z_motion
  full_name: Z_Motion
  vendor: catie
  socs:
    - name: nrf52833
```
